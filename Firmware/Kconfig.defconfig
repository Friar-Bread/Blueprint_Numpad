## Firmware/Kconfig.defconfig
```kconfig
if SHIELD_O_NUMPAD

# Name must be less than 16 characters long!
config ZMK_KEYBOARD_NAME
    default "o-numpad"

endif
```

## Firmware/Kconfig.shield
```kconfig
# No whitespace after the comma or in your keyboard name!
config SHIELD_O_NUMPAD
    def_bool $(shields_list_contains,o_numpad)
```
